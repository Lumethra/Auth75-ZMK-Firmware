#include <behaviors.dtsi>
#include <dt-bindings/zmk/keys.h>

/ {
    compatible = "zmk,keymap";

    keymap {
        default_layer {
            display-name = "Default Layer";
            // -----------------------------------------------------------------------------------------
            // | ESC | F1  | F2  | F3  | F4  | F5  | F6  | F7  | F8  | F9  | F10 | F11 | F12 | DEL  |
            // |  `  |  1  |  2  |  3  |  4  |  5  |  6  |  7  |  8  |  9  |  0  |  -  |  =  | BSPC |
            // | TAB |  Q  |  W  |  E  |  R  |  T  |  Y  |  U  |  I  |  O  |  P  |  [  |  ]  |  \   |
            // | CAPS|  A  |  S  |  D  |  F  |  G  |  H  |  J  |  K  |  L  |  ;  |  '  |    ENTER   |
            // | SHFT|  Z  |  X  |  C  |  V  |  B  |  N  |  M  |  ,  |  .  |  /  | SHFT| UP |       |
            // | CTRL| WIN | ALT |     SPACE     | ALT | FN  | CTRL| LFT | DWN | RGT | K_I | FPRINT |
            bindings = <
                &kp ESC     &kp F1      &kp F2      &kp F3      &kp F4      &kp F5  &kp F6      &kp F7      &kp F8      &kp F9      &kp F10     &kp F11     &kp F12     &kp DEL
                &kp GRAVE   &kp N1      &kp N2      &kp N3      &kp N4      &kp N5  &kp N6      &kp N7      &kp N8      &kp N9      &kp N0      &kp MINUS   &kp EQUAL   &kp BSPC
                &kp TAB     &kp Q       &kp W       &kp E       &kp R       &kp T   &kp Y       &kp U       &kp I       &kp O       &kp P       &kp LBKT    &kp RBKT    &kp BSLH
                &kp CLCK    &kp A       &kp S       &kp D       &kp F       &kp G   &kp H       &kp J       &kp K       &kp L       &kp SEMI    &kp SQT     &kp ENTER   &none
                &kp LSHIFT  &kp Z       &kp X       &kp C       &kp V       &kp B   &kp N       &kp M       &kp COMMA   &kp DOT     &kp FSLH    &kp RSHIFT  &kp UP      &none
                &kp LCTRL   &kp LGUI    &kp LALT    &kp SPACE   &kp RALT    &mo 1   &kp RCTRL   &kp LEFT    &kp DOWN    &kp RIGHT   &kp C_PP    &kp C_MUTE  &none       &none
            >;
        }
    };
};