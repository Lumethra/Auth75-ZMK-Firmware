## Kconfig
```kconfig
config ZMK_BEHAVIOR_AUTH75_LED
    bool
    default y
    depends on DT_HAS_ZMK_BEHAVIOR_AUTH75_LED_ENABLED

config GPIO_AUTH75_PCA9536
    bool
    default y
    depends on DT_HAS_AUTH75_PCA9536_ENABLED
    depends on I2C
```

## boards/shields/auth75/Kconfig.defconfig
```kconfig
if SHIELD_AUTH75

config ZMK_KEYBOARD_NAME
    default "Auth75"

endif # SHIELD_AUTH75
```

## dts/bindings/behaviors/zmk,behavior-auth75-led.yaml
```yaml
description: Auth75 fingerprint LED control
compatible: "zmk,behavior-auth75-led"
include: one_param.yaml
```

## dts/bindings/behaviors/zmk,behavior-led-control.yaml
```yaml
description: Select one PCA9536 LED
compatible: "zmk,behavior-led-control"
include: zero_param.yaml

properties:
  gpios:
    type: phandle-array
    required: true
  target:
    type: int
    required: true
  state:
    type: int
    required: true
```

## dts/bindings/gpio/auth75,pca9536.yaml
```yaml
description: Auth75 PCA9536 4-bit I2C GPIO expander
compatible: "auth75,pca9536"
include: [gpio-controller.yaml, i2c-device.yaml]

properties:
  "#gpio-cells":
    const: 2

gpio-cells:
  - pin
  - flags
```
